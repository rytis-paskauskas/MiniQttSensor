## main/Kconfig.projbuild
```kconfig
menu "IoT device configuration"
    menu "MQTT settings"
        config MQTT_BROKER_URI
            string "Broker URI"
            default "mqtts://localhost:8883"
            help
                The Broker's address (the part after slashes) must exactly match the declaration in the broker's certificate.
                The substitutions won't work, for example 127.0.0.1, localhost, or any of its aliases ARE NOT INTERCHANGEABLE.
        config MQTT_CLIENT_TOPIC_HEADER
            string "Topic basename"
                default "sense/sht3x"
                help
                The actual topic will be constructed from this variable and the MAC address as BASENAME/MAC, i.e. each device running this app with a unique MAC address will get a unique topic. Additional information (warnings) will be published to BASENAME/log and the log message will carry the MAC identifier.
    endmenu
    menu "WiFi connection settings"
        config WIFI_SSID
            string "WiFi SSID"
            default "wifi_ssid"
        config WIFI_PASSWORD
            string "WiFi Password"
            default "wifi_secret"
    endmenu
    menu "sht3x sensor settings"
        config MEASUREMENT_REFRESH_PERIOD
            int "Sensor measurement refresh period in seconds"
            range 1 3600
            default 5
            help
                Seconds to wait between two consecutive sensor measurements.
    endmenu
endmenu
menu "Client configuration"
    menu "MySQL database"
        config DB_URI
            string "MySQL URI"
            default "localhost"
            help
                Location of the database. Default is local DB.
        config DB_DBNAME
            string "Database name"
            default "myqttsense"
            help
                Please provide name of an existing database.
                It is possible to use myqttsense_client.py to create the database (see the docstring).
        config DB_USERNAME
            string "Database username"
            default "sql_user"
            help
                Please provide valid user that has privileges to modify the database.
        config DB_PASSWORD
            string "Database password"
            default "sql_secret"
            help
                Please provide valid password.
    endmenu
endmenu
```
